// SPDX-License-Identifier: (GPL-2.0+ OR MIT)
/*
 * Copyright (c) 2025 HZHY Electronics Co., Ltd.
 * HZ-RK3506SP MiniEVM — eMMC boot variant.
 */

/dts-v1/;

#include "HZ-RK3506SP_MiniEVM.dtsi"
#include "HZ-RK3506SP_MiniEVM_HDMI.dtsi"

/ {
	model = "HZ-RK3506SP_MiniEVM EMMC";
	compatible = "rockchip,rk3506-evb1-v10", "rockchip,rk3506";
	chosen {
		bootargs = "earlycon=uart8250,mmio32,0xff0a0000 console=ttyS0,1500000 root=/dev/mmcblk0p2 rw rootwait net.ifnames=0";
	};
	/delete-node/ sdio-pwrseq;
};

&mmc {
	/delete-property/ no-mmc;
	/delete-property/ disable-wp;
	/delete-property/ cd-gpios;
	/delete-property/ cd-debounce-delay-ms;
	/delete-property/ sd-uhs-sdr104;
	/delete-property/ mmc-pwrseq;
	no-sdio;
	no-sd;
	cap-mmc-highspeed;
	non-removable;
	bus-width = <4>;
	pinctrl-names = "default";
	pinctrl-0 = <&sdmmc_clk_pins &sdmmc_cmd_pins &sdmmc_bus4_pins>;
	vmmc-supply = <&vcc_3v3>;
	status = "okay";
};
