// SPDX-License-Identifier: (GPL-2.0+ OR MIT)
/*
 * Copyright (c) 2025 HZHY Electronics Co., Ltd.
 * HZ-RK3506SP MiniEVM — SD/TF card boot variant.
 */

/dts-v1/;

#include "HZ-RK3506SP_MiniEVM_NAND.dts"

/ {
	model = "HZ-RK3506SP_MiniEVM SD";
	compatible = "rockchip,rk3506-evb1-v10", "rockchip,rk3506";
	chosen {
		bootargs = "earlycon=uart8250,mmio32,0xff0a0000 console=ttyS0,1500000 rootfstype=ext4 root=PARTUUID=614e0000-0000 rw rootwait net.ifnames=0";
	};
	/delete-node/ sdio-pwrseq;
};
